#include <behaviors.dtsi>
#include <dt-bindings/zmk/keys.h>
#include <dt-bindings/zmk/bt/h>
#include <dt-bindings/zmk/ext_power.h>


/{
    keymap {
        compatible = "zmk, keymap";
        
        default_layer {
            bindings = <
                &kp KP_N7   &kp KP_N7   &kp KP_N7   &kp KP_N7   &kp KP_N7   &kp KP_N7   &kp KP_N7
                &kp KP_N7   &kp KP_N7   &kp KP_N7   &kp KP_N7   &kp KP_N7   &kp KP_N7   &kp KP_N7
                &kp KP_N7   &kp KP_N7   &kp KP_N7   &kp KP_N7   &kp KP_N7   &kp KP_N7   &kp KP_N7
                &kp KP_N7   &kp KP_N7   &kp KP_N7   &kp KP_N7   &kp KP_N7   &kp KP_N7   &kp KP_N7
                &kp KP_N7   &kp KP_N7   &kp KP_N7
                &kp KP_N7   &kp KP_N7   &kp KP_N7
            >;
        };
        
        bt_layer {
            bindings = <
                &none       &bt BT_SEL0   &bt BT_SEL1   &bt BT_SEL   &bt BT_CLR   &bootloader
                &none           &none           &none           &none       &none       &none
                &none           &none           &none           &none       &none       &none
                &none           &none           &none           &none       &none       &none
                &none           &none           &none
                &none           &none           &none
            >;
        };
    };
};
