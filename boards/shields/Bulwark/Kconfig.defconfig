## boards/shields/Bulwark/Kconfig.defconfig
```kconfig
if SHIELD_BULWARK

config ZMK_BULWARK
    string "Bulwark"
    default "Bulwark"

endif
```

## config/Kconfig.shield
```kconfig
# Copyright (c) 2024 Nathan McLachlain
# SPDX-License-Identifier: MIT

config SHIELD_BULWARK
    def_bool $(shields_list_contains, Bulwark)
```

## config/boards/shields/Bulwark/Kconfig.defconfig
```kconfig
config SHIELD_BULWARK
    bool "Enable Bulwark Shield"
    default=y

config ZMK_KEYBOARD_NAME
    default "Bulwark" if SHIELD_BULWARK
```
